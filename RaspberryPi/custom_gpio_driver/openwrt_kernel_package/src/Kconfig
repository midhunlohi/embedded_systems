## RaspberryPi/custom_gpio_driver/openwrt_kernel_package/src/Kconfig
```kconfig
config GPIO_CUSTOM
	tristate "Custom GPIO driver for LED"
	select GPIO
	help
	  This module is a custom GPIO driver for LED
```
